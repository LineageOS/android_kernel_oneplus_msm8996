## drivers/nfc/pn544_op/Kconfig
```kconfig
config NFC_PN544_OP
	tristate "NXP PN544 NFC driver"
	depends on I2C
	default n
	---help---
	  NXP PN544 core driver.
	  This is a driver based on the HCI NFC kernel layers and
	  will thus not work with NXP libnfc library.

	  To compile this driver as a module, choose m here. The module will
	  be called pn544.
	  Say N if unsure.
```

## fs/sdcardfs/Kconfig
```kconfig
config SDCARD_FS
	tristate "sdcard file system"
	default n
	help
	  Sdcardfs is based on Wrapfs file system.

config SDCARD_FS_FADV_NOACTIVE
	bool "sdcardfs fadvise noactive support"
	depends on SDCARD_FS && FADV_NOACTIVE
	default y
	help
	  Sdcardfs supports fadvise noactive mode.

config SDCARD_FS_XATTR
	bool "Sdcardfs extended attribute"
	default y
	depends on SDCARD_FS
	help
	  Modification of sdcard file system for xattr
```
